## software/esp32/applications/level_gauge/main/Kconfig.projbuild
```kconfig
menu "FGR Application Configuration"

    config FGR_APP_NO_WIFI
        bool "Omit connecting to Wi-Fi (and therefore omit doing an OTA update)"
        default n
        help
            Set to omit making a WiFi connection

endmenu
```

## software/esp32/applications/level_gauge/sdkconfig.defaults
```kconfig
# Default sdkconfig parameters, designed to be used with OTA and for maximum robustness

# Use a customer partition table for best use of the 4 Mbyte flash
CONFIG_PARTITION_TABLE_CUSTOM=y
CONFIG_PARTITION_TABLE_CUSTOM_FILENAME="partitions.csv"
CONFIG_PARTITION_TABLE_FILENAME="partitions.csv"

# Force a 4 Mbyte flash size, in case of misdetection
CONFIG_ESPTOOLPY_FLASHSIZE_4MB=y
# Uncomment this line if, for some reason, you decide not to use a custom
# partition table and want a good set of defaults for OTA
# CONFIG_PARTITION_TABLE_TWO_OTA=y

# Enable stack checking in all functions to catch memory corruption early
CONFIG_COMPILER_STACK_CHECK_MODE_ALL=y

# Verify all flash writes to ensure data integrity
CONFIG_SPI_FLASH_VERIFY_WRITE=y
# Explicitly disable NVS encryption to keep the storage simple and robust
CONFIG_NVS_ENCRYPTION=n

# Enable the Interrupt WDT to catch blocked interrupts (default anyway, but just in case)
CONFIG_ESP_INT_WDT=y
# Enable the Task WDT to catch stuck tasks (default anyway, but just in case)
CONFIG_ESP_TASK_WDT=y
# Make the Task WDT cause a panic (and thus a reset) on timeout
CONFIG_ESP_TASK_WDT_PANIC=y

# Enable panic handler to print backtrace to serial console (default anyway, but just in case)
CONFIG_ESP_SYSTEM_PANIC_PRINT_BACKTRACE=y
```

## software/esp32/applications/test/sdkconfig.defaults
```kconfig
# Default sdkconfig parameters, designed to be used with OTA and for maximum robustness

# Use a customer partition table for best use of the 4 Mbyte flash
CONFIG_PARTITION_TABLE_CUSTOM=y
CONFIG_PARTITION_TABLE_CUSTOM_FILENAME="partitions.csv"
CONFIG_PARTITION_TABLE_FILENAME="partitions.csv"

# Force a 4 Mbyte flash size, in case of misdetection
CONFIG_ESPTOOLPY_FLASHSIZE_4MB=y
# Uncomment this line if, for some reason, you decide not to use a custom
# partition table and want a good set of defaults for OTA
# CONFIG_PARTITION_TABLE_TWO_OTA=y

# Enable stack checking in all functions to catch memory corruption early
CONFIG_COMPILER_STACK_CHECK_MODE_ALL=y

# Verify all flash writes to ensure data integrity
CONFIG_SPI_FLASH_VERIFY_WRITE=y
# Explicitly disable NVS encryption to keep the storage simple and robust
CONFIG_NVS_ENCRYPTION=n

# Enable the Interrupt WDT to catch blocked interrupts (default anyway, but just in case)
CONFIG_ESP_INT_WDT=y
# Enable the Task WDT to catch stuck tasks (default anyway, but just in case)
CONFIG_ESP_TASK_WDT=y
# 15 second watchog time, though fgr_monitor will come 5 seconds before this:
# long enough to connect to WiFi and do an OTA update
CONFIG_ESP_TASK_WDT_TIMEOUT_S=15
# Make the Task WDT cause a panic (and thus a reset) on timeout
CONFIG_ESP_TASK_WDT_PANIC=y

# Enable core dumps (needs coredump region of size at least 64 kbytes in partitions.csv)
CONFIG_ESP_COREDUMP_ENABLE_TO_FLASH=y
CONFIG_ESP_COREDUMP_DATA_FORMAT_ELF=y
```

## software/esp32/components/fgr_debug/Kconfig.projbuild
```kconfig
menu "FGR Debug Configuration"

    config FGR_DEBUG_LED_PIN
        int "Debug LED pin"
        default 21
        help
            The pin where a debug LED is connected: on an ESP32 C3 super mini board
            a single colour debug LED is usually on pin 8 whereas on an ESP32 S3
            super mini board the WS2812 RGB LED is usually on pin 21 (and
            you will need to set CONFIG_FGR_DEBUG_LED_SPI_NUM also).

    config FGR_DEBUG_LED_SPI_NUM
        int "The SPI port to use for a WS2812 RGB LED"
        default 2
        range -1 3
        help
            Set this to -1 for a single colour LED (e.g. as usually found on an
            ESP32 C3 super mini board), set it to a valid SPI HW block number
            for the WS2812 RGB LED usually found on the ESP32 S3 super mini board
            DO NOT USE SPI 0 or 1: these are hard-wired internally to flash memory

endmenu
```

## software/esp32/components/fgr_lib/Kconfig.projbuild
```kconfig
menu "FGR Lib Configuration"

    config FGR_LIB_SKIP_OTA_UPDATE
        bool "Set this to skip OTA updates: NEVER set this on an image built with nodes_esp32_deploy.py"
        default n
        help
            Skip an OTA update: be careful not to set this on anything built using
            nodes_esp32_deploy.py as you will lock nodes out of OTA updates forever.

endmenu
```

## software/esp32/components/fgr_log/Kconfig.projbuild
```kconfig
menu "FGR Log Configuration"

    config FGR_LOG_PORT
        int "The port number of the logging collector on the controller"
        default 5001
        range 1024 65535

    config FGR_LOG_HEARTBEAT_SECONDS
        int "how often to check the underlying channel"
        default 60
        range 30 65535
        help
            If metrics are being sent to logging, set this to more than the
            metrics period for maximum efficiency.

endmenu
```

## software/esp32/components/fgr_metrics/Kconfig.projbuild
```kconfig
menu "FGR Metrics Configuration"

    config FGR_METRICS_PERIOD_SECONDS
        int "how often to collect timed metrics and report them"
        default 30
        range 10 65535
        help
            Set to less than the log heartbeat for maximum efficiency and not the
            same as the message heartbeat to avoid peaky send activity.

    config FGR_METRICS_RSSI_AVERAGE_TIME_SECONDS
        int "how long to average the RSSI over"
        default 10
        range 1 10

endmenu
```

## software/esp32/components/fgr_msg/Kconfig.projbuild
```kconfig
menu "FGR Message Configuration"

    config FGR_MSG_PORT
        int "The messaging port number of the controller"
        default 5000
        range 1024 65535

    config FGR_MSG_HEARTBEAT_SECONDS
        int "how often to check the underlying channel"
        default 50
        range 30 65535

endmenu
```

## software/esp32/components/fgr_network/Kconfig.projbuild
```kconfig
menu "FGR Network Configuration"

    config FGR_NETWORK_WIFI_SSID
        string "WiFi SSID"
        default "FGR"
        help
            SSID (network name) to connect to.

    config FGR_NETWORK_WIFI_PASSWORD
        string "Wi-Fi Password"
        default ""
        help
            WiFi password (WPA or WPA2) to use.
            Can be left blank if the network has no security set.

    config FGR_NETWORK_CONTROLLER_IP_ADDRESS
        string "IP address of the controller"
        default "10.10.3.1"
        help
            IP address of the controller

endmenu
```

## software/esp32/components/fgr_ota/Kconfig.projbuild
```kconfig
menu "FGR OTA Configuration"

    config FGR_OTA_FIRMWARE_UPGRADE_URL
        string "Firmware Upgrade URL"
        default "https://10.10.3.1:8070/update"
        help
            URL of the firmware image, default designed to be used
            with https_server.py running in differentiated mode;
            for non-differentiated mode using a file name directly,
            e.g. https://10.10.3.1:8070/default.bin

    config FGR_OTA_RECEIVE_TIMEOUT_MS
        int "OTA Receive Timeout in milliseconds"
        default 5000
        help
            Maximum time for reception

endmenu
```

## software/esp32/components/fgr_rcwl9610a/Kconfig.projbuild
```kconfig
menu "FGR RCWL-9610A Configuration"

    config FGR_RCWL9610A_UART_NUM
        int "UART_NUM"
        default 1
        help
            UART number to use for the RCWL-9610A

    config FGR_RCWL9610A_UART_TXD_PIN
        int "TXD pin"
        default 6
        help
            UART TX pin wired to the RCWL-9610A

    config FGR_RCWL9610A_UART_RXD_PIN
        int "RXD pin"
        default 5
        help
            UART RX pin wired to the RCWL-9610A

endmenu
```
